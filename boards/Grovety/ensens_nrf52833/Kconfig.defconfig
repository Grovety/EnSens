## boards/Grovety/ensens_nrf52833/Kconfig.defconfig
```kconfig
# SPDX-License-Identifier: Apache-2.0

if BOARD_ENSENS_NRF52833

config BT_CTLR
	default BT

endif # BOARD_ENSENS_NRF52833
```

## boards/Grovety/ensens_nrf52833/Kconfig.ensens_nrf52833
```kconfig
# SPDX-License-Identifier: Apache-2.0

config BOARD_ENSENS_NRF52833
	select SOC_NRF52833_QIAA
```

## drivers/Kconfig
```kconfig
#
# Copyright (c) 2018-2020 Nordic Semiconductor ASA
#
# SPDX-License-Identifier: LicenseRef-Nordic-5-Clause
#

menu "Device Drivers"

rsource "sensor/Kconfig"

endmenu
```

## drivers/sensor/Kconfig
```kconfig
#
# Copyright (c) 2023 Nordic Semiconductor
#
# SPDX-License-Identifier: LicenseRef-Nordic-5-Clause
#

menuconfig SENSOR
	bool "Sensor Drivers"
	help
		Include sensor drivers in config

if SENSOR

rsource "bme68x_iaq/Kconfig"

endif # SENSOR
```
