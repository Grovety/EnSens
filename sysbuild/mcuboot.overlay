/*
 * SPDX-License-Identifier: Apache-2.0
 */

/ {
	aliases {
		mcuboot-button0 = &button0;
		mcuboot-led0 = &led0;
	};
};

/* Configure CDC ACM */
&zephyr_udc0 {
	cdc_acm_uart0: cdc_acm_uart0 {
		compatible = "zephyr,cdc-acm-uart";
	};
};
